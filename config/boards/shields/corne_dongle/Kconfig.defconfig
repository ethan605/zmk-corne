## config/boards/shields/corne_dongle/Kconfig.defconfig
```kconfig
if SHIELD_CORNE_DONGLE

# This name shows up in your OS's USB device list
# Max 16 characters
config ZMK_KEYBOARD_NAME
    default "Corne Dongle"

config ZMK_SPLIT_ROLE_CENTRAL
    default y

config ZMK_SPLIT
    default y

# 2 peripherals: left half + right half
config ZMK_SPLIT_BLE_CENTRAL_PERIPHERALS
    default 2

# BT_MAX_CONN = peripherals + BT host profiles
# 2 peripherals + 2 BT host profiles = 4
config BT_MAX_CONN
    default 4

config BT_MAX_PAIRED
    default 4

# USB output since the dongle connects via USB
config ZMK_USB
    default y

config ZMK_BLE
    default y

endif
```

## config/west.yml
```yaml
manifest:
  remotes:
    - name: zmkfirmware
      url-base: https://github.com/zmkfirmware
    - name: ethan605
      url-base: https://github.com/ethan605
  projects:
    - name: zmk
      remote: zmkfirmware
      revision: edf5c0814fd3ea202e43aad2d68fd32e882a518c   # v0.3.0
      import: app/west.yml       # Pulls in Zephyr and all ZMK dependencies
    - name: zmk-dongle-screen
      remote: ethan605
      revision: 3a8709f84cfceff6335a77b88e3d829394588ae9   # Dongle screen redesign: connections one-liner, 2x2 modifiers, enlarged roller, Snazzy palette
  self:
    path: config
```
